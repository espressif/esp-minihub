## components/minihub_mqtt_broker/Kconfig.minihub
```kconfig
menu "MQTT broker"

    config MINIHUB_MQTT_BROKER
        bool "Enable on-device MQTT broker"
        default y
        help
            Run an mosquitto broker on the Hub (TCP 1883) so MQTT devices at
            the site connect to the Hub itself instead of a separate always-on
            machine. The broker is a pure transport service: it carries no Hub
            points. At run time adapters.mqtt_broker.enabled decides whether it
            listens (factory seed: off), and that same flag starts the Hub's own
            loopback MQTT client, which is what host.mqtt rides on. Turning this
            option off therefore also drops CONFIG_MINIHUB_MQTT_ADAPTER and
            CONFIG_MINIHUB_JS_MQTT: a product without an on-device broker has no
            MQTT client either.

            After flipping this option in an existing build directory, build
            twice (or run reconfigure first). The component manager evaluates
            the espressif/mosquitto rule against build/config/sdkconfig.json,
            which kconfgen only writes later in the same configure pass, so the
            first build still sees the previous value and drops the package:
            "mosq_broker.h: No such file or directory". Turning the option off
            needs no second pass, and a fresh build directory resolves in one.

endmenu
```

## components/minihub_net/Kconfig.minihub
```kconfig
menu "Networking"

    config MINIHUB_NET_WIFI_STA
        bool "Enable Wi-Fi STA"
        default y
        help
            Start Wi-Fi station (credentials from Kconfig / NVS / SoftAP or BLE provision).

    config MINIHUB_NET_WIFI_SOFTAP
        bool "Wi-Fi SoftAP in use (external stack)"
        default n
        help
            Product uses 2.4 GHz Wi-Fi SoftAP and/or STA outside minihub_net
            while MINIHUB_NET_WIFI_STA is disabled. Set n for ETH-only Host.
            Enables RF coexistence hooks (esp_coex_wifi_i154) for Zigbee on S31.

    config MINIHUB_NET_ETH
        bool "Enable Ethernet (native EMAC)"
        depends on SOC_EMAC_SUPPORTED
        default y if IDF_TARGET_ESP32S31
        default n
        help
            Start native EMAC + PHY (ESP32-S31 Function CoreBoard: YT8531DC-CA RGMII).
            Mutually exclusive with MINIHUB_LCD_UI (EMAC and RGB LCD share pin groups
            on Korvo1; Function CoreBoard has RJ45 and no LCD). Enable ETH only when
            LCD UI is disabled (MINIHUB_LCD_UI depends on !MINIHUB_NET_ETH).

    config MINIHUB_NET_ETH_PHY_ADDR
        int "Ethernet PHY address (-1 = auto)"
        depends on MINIHUB_NET_ETH
        range -1 31
        default -1

    config MINIHUB_NET_ETH_PHY_RST_GPIO
        int "Ethernet PHY reset GPIO (-1 = unused)"
        depends on MINIHUB_NET_ETH
        range -1 63
        default 7 if IDF_TARGET_ESP32S31
        default -1

    config MINIHUB_NET_ETH_YT8531_INIT
        bool "YT8531DC-CA RGMII PHY chip-specific init"
        depends on MINIHUB_NET_ETH && IDF_TARGET_ESP32S31
        default y
        help
            Motorcomm YT8531DC-CA on ESP32-S31 Function CoreBoard.
            Re-enable auto-negotiation after reset and set RGMII Tx/Rx delays
            (same sequence as IDF examples/ethernet/basic).

endmenu
```

## components/minihub_ota/Kconfig.minihub
```kconfig
menu "OTA"

    config MINIHUB_OTA_EXTERNAL_STORAGE
        bool "Stage firmware to external storage (SD card / USB drive)"
        default y
        help
            When enabled (default), firmware upgrades are staged to a LittleFS
            volume on an SD card or USB drive and applied by Vibe Mode (the
            factory recovery image). The operator chooses which medium — SD card,
            USB drive, or both with failover — in the web console or LCD System
            screen.

            When disabled, upgrades use the internal dual-slot A/B layout
            (ota_0 / ota_1): the image is written straight to the inactive slot
            and the device reboots into it. This needs a partition table that
            defines ota_1 (see application/minihub/partitions_int.csv). Pick this
            when operators do not want to depend on an SD card or USB stick.

endmenu
```

## components/minihub_protocol_adapters/adapter_modbus/Kconfig.minihub
```kconfig
menu "Modbus"

    config MINIHUB_MODBUS
        bool "Enable Modbus client (esp-modbus TCP / RTU)"
        default y

    if MINIHUB_MODBUS
        config MINIHUB_MODBUS_UART_NUM
            int "Default UART port for Modbus RTU"
            default 1
            range 0 2

        config MINIHUB_MODBUS_UART_TXD
            int "Default Modbus RTU TX GPIO (-1 = require adapters.json)"
            default -1

        config MINIHUB_MODBUS_UART_RXD
            int "Default Modbus RTU RX GPIO (-1 = require adapters.json)"
            default -1

        config MINIHUB_MODBUS_UART_RTS
            int "Default Modbus RTU RTS / DE~RE GPIO (-1 = no RS485 direction pin)"
            default -1
    endif

endmenu
```

## components/minihub_protocol_adapters/adapter_mqtt/Kconfig.minihub
```kconfig
menu "MQTT adapter"

    config MINIHUB_MQTT_ADAPTER
        bool "Enable MQTT Hub adapter"
        depends on MINIHUB_MQTT_BROKER
        default y
        help
            MQTT client for the Hub's own broker. It connects to 127.0.0.1 on
            the port in adapters.mqtt_broker and carries the host.mqtt bridge
            that L2 plugins use, so it only exists while the on-device broker is
            compiled in; there is no external-broker mode. Whether it runs is
            the same adapters.mqtt_broker.enabled flag that starts the listener.

endmenu
```

## components/minihub_provision/Kconfig.minihub
```kconfig
menu "Provisioning"

    config MINIHUB_WIFI_SSID
        string "WiFi SSID"
        default "YOUR_SSID"
        help
            Leave as YOUR_SSID to use NVS / SoftAP provisioning instead.

    config MINIHUB_WIFI_PASS
        string "WiFi Password"
        default "YOUR_PASSWORD"

    config MINIHUB_WIFI_PROVISIONING
        bool "Enable Wi-Fi provisioning when SSID not set"
        default y
        help
            When Kconfig/NVS have no Wi-Fi credentials, start provisioning.
            The only transport is SoftAP (no Bluetooth). The shipped Host serves
            its console on port 80, so minihub_net brings up a plain open AP
            instead of the network_provisioning HTTP server; a product that moves
            the console can call minihub_provision_start() to use the manager.

    config MINIHUB_FACTORY_RESET_BUTTON
        bool "BOOT button long-press factory reset (erase NVS)"
        default n

    config MINIHUB_FACTORY_RESET_GPIO
        int "Factory-reset button GPIO"
        depends on MINIHUB_FACTORY_RESET_BUTTON
        default 61
        range 0 61

    config MINIHUB_FACTORY_RESET_HOLD_MS
        int "Factory-reset hold time (ms)"
        depends on MINIHUB_FACTORY_RESET_BUTTON
        default 5000
        range 1000 30000

    config MINIHUB_FACTORY_RESET_ACTIVE_LOW
        bool "Factory-reset button is active low"
        depends on MINIHUB_FACTORY_RESET_BUTTON
        default y

endmenu
```

## components/minihub_rainmaker/Kconfig.minihub
```kconfig
menu "RainMaker"

    config MINIHUB_RAINMAKER
        bool "Enable ESP RainMaker bridge"
        default y

endmenu
```
