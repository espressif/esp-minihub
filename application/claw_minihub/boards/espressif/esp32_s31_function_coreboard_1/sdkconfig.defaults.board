## cmake/minihub_bundle/Kconfig.projbuild
```kconfig
# Top-level MiniHub menu. Fragment files are Kconfig.minihub (not named
# Kconfig) so IDF does not also mount them at the project root.
# This file is auto-loaded when minihub_bundle is in the build graph.
menu "MiniHub"

    config MINIHUB_VERSION
        string "MiniHub Version"
        default "0.1.0-dev"
        help
            Single version for the device: reported by the firmware as
            firmware_version (OTA comparison), used by tools/deploy.sh as the
            Firmwares/<chip>/<version>/ folder name, and shown in the Web
            sidebar / system page as v<version>. This is not the git describe
            string; that is reported separately as the commit line.

    config MINIHUB_BOARD
        string "MiniHub board id (Store / OTA ?board=)"
        default ""
        help
            Product board string sent on Store and OTA requests as ?board=.
            Independent of esp_board_manager's CONFIG_ESP_BOARD_NAME (hardware
            pinmux id). Products set this in configs/sdkconfig/feature/board.defaults
            — e.g. ESP32-S31-Function-Coreboard-1 (minihub) or
            ESP32-S31-Korvo-1 (minihub_lcd). Empty means the query is omitted.

    config MINIHUB_RELEASE
        bool "Release build (Warning log level)"
        default n
        select LOG_DEFAULT_LEVEL_WARN
        select LOG_MAXIMUM_EQUALS_DEFAULT
        select BOOTLOADER_LOG_LEVEL_WARN
        select BT_NIMBLE_LOG_LEVEL_WARNING if BT_NIMBLE_ENABLED
        select BROOKESIA_UTILS_LOG_LEVEL_WARNING if MINIHUB_LCD_UI
        select LV_LOG_LEVEL_WARN if LV_USE_LOG
        help
            Production-oriented logging. Tries to select Warning for the app
            default/maximum log level and the bootloader. Optional stacks only
            when present: NimBLE (BT_NIMBLE_ENABLED), Brookesia (MINIHUB_LCD_UI),
            LVGL (LV_USE_LOG).

            Note: Kconfig `select` on choice members often does not rewrite an
            already-saved sdkconfig (e.g. LOG_DEFAULT_LEVEL_INFO left from an
            older defaults fragment). For a reliable release image use
            ./tools/build_firmware.py --release, or add `release` to the product
            app.yml features list (both load release.defaults and rewrite the
            saved sdkconfig).

    rsource "../../components/minihub_core/Kconfig.minihub"
    rsource "../../components/minihub_mcp_server/Kconfig.minihub"
    rsource "../../components/minihub_net/Kconfig.minihub"
    menu "Plugins"
        rsource "../../components/minihub_store/Kconfig.minihub"
        rsource "../../components/minihub_module/Kconfig.minihub"
        rsource "../../components/minihub_js/Kconfig.minihub"
    endmenu
    menu "Builtin Adapters"
        rsource "../../components/minihub_ble_mesh/Kconfig.minihub"
        rsource "../../components/minihub_thread/Kconfig.minihub"
        rsource "../../components/minihub_zigbee/Kconfig.minihub"
        rsource "../../components/minihub_matter/Kconfig.minihub"
        rsource "../../components/minihub_mqtt_broker/Kconfig.minihub"
        rsource "../../components/minihub_protocol_adapters/adapter_modbus/Kconfig.minihub"
        rsource "../../components/minihub_rtsp_cam/Kconfig.minihub"
    endmenu
    menu "Firmware update"
        rsource "../../components/minihub_ota/Kconfig.minihub"
        rsource "../../components/minihub_vibe/Kconfig.minihub"
    endmenu
    menu "Peripherals"
        rsource "../../components/minihub_usb_msc/Kconfig.minihub"
    endmenu

    config MINIHUB_LOCAL_MAP
        bool "Enable local map"
        default n
        help
            Build IP geolocation and the map. This makes outbound requests
            to third-party services. Web and LCD show a map only when this
            is on. When off, the map code is left out and neither UI offers
            a map.

    menu "UI"
        rsource "../../components/minihub_lcd/Kconfig.minihub"
        rsource "../../components/minihub_web/Kconfig.minihub"
    endmenu
    menu "Cloud"
        rsource "../../components/minihub_rainmaker/Kconfig.minihub"
    endmenu
    rsource "../../components/minihub_provision/Kconfig.minihub"

endmenu
```

## components/minihub_auth/Kconfig.minihub
```kconfig
menu "Auth"

    config MINIHUB_WEB_LOGIN_AUTH
        bool "Require Web login (admin + NVS password)"
        depends on MINIHUB_WEB_UI
        default y

    config MINIHUB_WEB_LOGIN_AUTH_TOKEN
        string "REST Bearer token (empty = cookie only)"
        depends on MINIHUB_WEB_LOGIN_AUTH
        default ""
        help
            Scripts and LAN integrators authenticate with
            "Authorization: Bearer <this>". Empty by default, so a build from this
            tree accepts session cookies and the NVS key api_token (namespace
            minihub) and no shared string at all: a value compiled in here wins
            over NVS and would be the same on every unit, which is what makes it a
            product secret rather than a device secret.

            Set it only when every integrator of that deployment is meant to share
            one token; otherwise leave it empty and provision api_token per device.
            Clearing it does not disable REST auth: login is still required.

endmenu
```

## components/minihub_ble_mesh/Kconfig.minihub
```kconfig
menu "BLE Mesh"

    config MINIHUB_BLE_MESH_SDK
        bool "Enable BLE Mesh adapter (ESP-BLE-Mesh Provisioner)"
        default n
        select BT_ENABLED
        select BT_NIMBLE_ROLE_CENTRAL
        select BT_NIMBLE_ROLE_OBSERVER
        select BT_NIMBLE_GATT_CLIENT
        select BLE_MESH
        select BLE_MESH_PROVISIONER
        select BLE_MESH_PB_ADV
        select BLE_MESH_PB_GATT
        select BLE_MESH_CFG_CLI
        select BLE_MESH_GENERIC_ONOFF_CLI
        select BLE_MESH_GENERIC_LEVEL_CLI
        select BLE_MESH_LIGHT_LIGHTNESS_CLI
        select BLE_MESH_LIGHT_CTL_CLI
        select BLE_MESH_LIGHT_HSL_CLI
        select BLE_MESH_SENSOR_CLI

endmenu
```

## components/minihub_core/Kconfig.minihub
```kconfig
menu "Core"

    config MINIHUB_POINT_DEBOUNCE_MS
        int "Point update debounce (ms, 0=off)"
        default 1000
        range 0 10000

    config MINIHUB_HEAP_LOG_INTERVAL_SEC
        int "Periodic heap log interval (seconds, 0=off)"
        default 0
        range 0 3600

    config MINIHUB_HUB_RELOAD_STACK_SIZE
        int "hub_reload task stack size (bytes, PSRAM)"
        default 24576
        range 8192 65536
        help
            FreeRTOS stack for the async hub reload task. Reload walks
            config / packs / adapters before handing JS compile to
            js_worker; keep enough headroom for that call chain. JS
            evaluation itself does not run on this stack.

endmenu
```

## components/minihub_hub/Kconfig.minihub
```kconfig
menu "Hub"

    config MINIHUB_HUB_RELOAD_STACK_SIZE
        int "hub_reload task stack size (bytes, PSRAM)"
        default 24576
        range 8192 65536
        help
            FreeRTOS stack for the async hub reload task. Reload walks
            config / packs / adapters before handing JS compile to
            js_worker; keep enough headroom for that call chain. JS
            evaluation itself does not run on this stack.

endmenu
```

## components/minihub_js/Kconfig.minihub
```kconfig
menu "JS plugins"

    config MINIHUB_JS_PLUGINS
        bool "Enable L2 JS plugins (QuickJS-NG + Host API v0)"
        depends on MINIHUB_DYNAMIC_MODULES
        default y

    config MINIHUB_JS_WORKER_STACK_SIZE
        int "js_worker task stack size (bytes, PSRAM)"
        default 32768
        range 16384 131072
        depends on MINIHUB_JS_PLUGINS
        help
            FreeRTOS stack for the dedicated QuickJS worker. All JS_Eval /
            JS_Call run on this task so the runtime stack limit matches a
            single known stack. Raise if a large L2 script overflows during
            compile; lower only if PSRAM is scarce.

    config MINIHUB_JS_BLE
        bool "L2 host.ble: shared passive BLE advertisement scanner"
        depends on MINIHUB_JS_PLUGINS
        default n
        help
            Exposes host.ble.ensureScan() / releaseScan() / getAds() to L2
            plugins. All BLE vendor plugins share ONE NimBLE scan, reference
            counted, so enabling several of them does not restart the radio.
            Requires CONFIG_BT_NIMBLE_ENABLED and GATT client. When disabled
            the methods still exist but throw a clear "disabled" error, so
            plugin setup() can degrade gracefully.

    config MINIHUB_JS_MDNS
        bool "L2 host.mdns: one-shot mDNS service discovery"
        depends on MINIHUB_JS_PLUGINS
        default n
        help
            Exposes host.mdns.resolve({ service, proto, timeout_ms,
            max_results }), a blocking PTR/A query for LAN discovery.
            mDNS is initialised lazily and idempotently, so a Matter/Thread
            responder already running is left alone. Disabled by default to
            keep the firmware image unchanged for existing configurations.

    config MINIHUB_JS_MQTT
        bool "L2 host.mqtt: wildcard MQTT subscriptions for dynamic discovery"
        depends on MINIHUB_JS_PLUGINS && MINIHUB_MQTT_ADAPTER
        default n
        help
            Exposes host.mqtt.subscribe() / unsubscribe() / getMessages() /
            publish() / isConnected() / stats() to L2 plugins, backed by the
            bundled MQTT adapter's single esp-mqtt client. Filters may use
            MQTT '+' / '#' wildcards and are re-subscribed on broker reconnect.
            Messages matching a filter are copied into a bounded 24-slot ring
            buffer (2 KB payload cap); JS pulls them with getMessages() so no
            JSValue crosses the esp-mqtt task boundary. Disabled by default to
            keep the firmware image unchanged for existing configurations;
            when off the methods throw a clear "host.mqtt disabled" error.

    config MINIHUB_JS_WORKER_STACK_BUDGET
        int "QuickJS C-stack budget on js_worker (bytes)"
        default 24576
        range 8192 126976
        depends on MINIHUB_JS_PLUGINS
        help
            Passed to JS_SetMaxStackSize after JS_UpdateStackTop on
            js_worker. Must stay below MINIHUB_JS_WORKER_STACK_SIZE so a
            deep script throws "Maximum call stack size exceeded" instead
            of a hardware stack-protection fault. A value greater than or
            equal to the task stack fails the build.

endmenu
```

## components/minihub_lcd/Kconfig.minihub
```kconfig
menu "LCD UI"

    config MINIHUB_LCD_UI
        bool "Enable LCD UI (esp-brookesia JSON UI)"
        depends on !MINIHUB_NET_ETH
        default n
        help
            Mutually exclusive with Ethernet on some boards (EMAC vs RGB LCD).

    config MINIHUB_LCD_UI_REFRESH_MS
        int "LCD UI fallback resync period (ms)"
        depends on MINIHUB_LCD_UI
        default 30000
        range 500 300000
        help
            Point updates reach the screen through the Hub event bus, so this is
            not the refresh interval. It is how often the panel re-reads every
            point in case an event was dropped: a subscription that silently
            misses one update sticks, because a display has no reconnect. Set it
            high (the default is 30 s); the coalesce window that actually gates
            redraws is fixed at 100 ms in the firmware.

    config MINIHUB_LCD_UI_VERSION
        string "LCD UI bundle version"
        depends on MINIHUB_LCD_UI
        default MINIHUB_VERSION
        help
            Version stamped into /data/ui/version.txt and published under
            LCD_UI/v<ver>/ for GET /api/ui. Independent of firmware and web so a
            panel-only fix can ship without bumping either. Defaults to the
            product MINIHUB_VERSION.

endmenu
```

## components/minihub_matter/Kconfig.minihub
```kconfig
menu "Matter"

    config MINIHUB_MATTER_ADAPTER
        bool "Enable Matter adapter / commissioner"
        default n

    config MINIHUB_MATTER_THREAD_VIA_BLE_COMMISSION
        bool "Commission new Thread devices over BLE"
        depends on MINIHUB_MATTER_ADAPTER
        depends on MINIHUB_THREAD_ADAPTER
        default y
        help
            First-time Thread join: BLE scan plus injecting this Hub's Thread
            operational dataset (discovery ble_thread). Turn off to keep
            Matter-over-Thread on-network commissioning (discovery network)
            and skip the BLE controller scan. Wi-Fi and Ethernet BLE
            commissioning are unchanged.

    config MINIHUB_MATTER_MAX_NODES
        int "Max Matter nodes tracked (device / subscription / identity tables)"
        default 128
        range 16 1024
        depends on MINIHUB_MATTER_ADAPTER
        help
            Hard safety cap for the Matter device, subscription and identity
            tables. The tables are heap-allocated from PSRAM at init; raising
            it costs PSRAM, lowering it rejects extra devices with a log line
            instead of silently dropping them.

    config MINIHUB_MATTER_COMMISSION_WAIT_MS
        int "Commission watchdog timeout (ms)"
        default 300000
        range 60000 900000
        depends on MINIHUB_MATTER_ADAPTER
        help
            How long minihub_matter_commission_wait() blocks waiting for a
            commission to finish before the watchdog declares "commission
            timed out". Operational DNS-SD (resolving the joined device on the
            Thread/ethernet fabric) can be slow on first browse — the local
            OTBR record may not be visible immediately after commissioning —
            so give it headroom beyond the previous 180 s. Raise this if a
            slow fabric still trips the watchdog; lower it for faster test
            feedback.

endmenu
```

## components/minihub_mcp_server/Kconfig.minihub
```kconfig
menu "MCP"

    config MINIHUB_MCP_SERVER
        bool "Enable on-device MCP tool server (Hub tools for agents)"
        default y
        help
            Register MiniHub REST-equivalent tools via minihub_mcp_server.
            Requires ``git submodule update --init components/esp-claw``
            (cap_mcp_server). Used by idf_component.yml.

endmenu
```

## components/minihub_module/Kconfig.minihub
```kconfig
menu "Modules"

    config MINIHUB_DYNAMIC_MODULES
        bool "Enable dynamic adapter module loader (.mhub / .so via elf_loader)"
        default n

    config MINIHUB_ELF_PLUGINS
        bool "Enable L3 ELF plugins (.so via elf_loader)"
        depends on MINIHUB_DYNAMIC_MODULES
        default y
        select ELF_LOADER
        select ELF_DYNAMIC_LOAD_SHARED_OBJECT
        help
            Load L3 .mhub shared objects with espressif/elf_loader.
            The .so base path stays the loader option (MiniHub uses /data).

    config MINIHUB_HUB_MAX_BYTES
        int "Max .mhub package size downloaded into PSRAM (bytes)"
        depends on MINIHUB_DYNAMIC_MODULES
        default 1048576
        range 65536 4194304

endmenu
```
