## components/minihub_rtsp_cam/Kconfig.minihub
```kconfig
menu "RTSP camera"

    config MINIHUB_RTSP_CAM
        bool "Enable RTSP → USB H.265 recorder"
        default n
        depends on MINIHUB_USB_MSC
        help
            Pull one RTSP stream and write Annex-B H.265 segments to the USB stick.

    config MINIHUB_RTSP_CAM_DEFAULT_URL
        string "Default RTSP URL"
        depends on MINIHUB_RTSP_CAM
        default ""
        help
            Empty by default: the recorder starts only from a URL that was set at
            runtime (Web UI, RPC or command, persisted in NVS) and refuses a start
            otherwise. A compiled-in URL would ship the same camera address in
            every unit built from this tree.

    config MINIHUB_RTSP_CAM_DEFAULT_SEGMENT_SEC
        int "Default segment length (seconds)"
        depends on MINIHUB_RTSP_CAM
        range 60 3600
        default 600
        help
            1–60 minutes expressed in seconds (default 10 min).

    config MINIHUB_RTSP_CAM_AUTO_START
        bool "Auto-start recording when USB mounts"
        depends on MINIHUB_RTSP_CAM
        default n
        help
            Unattended bring-up: start H.265 recording once /usb0 is mounted.
            Leave disabled for manual start via Web/RPC/command (turn_on/start).
            Default is off so the hub does not pull the camera stream until asked.

    config MINIHUB_RTSP_CAM_RELAY_PORT
        int "RTSP relay listen port (VLC/phone)"
        depends on MINIHUB_RTSP_CAM
        range 1024 65535
        default 8554
        help
            MiniHub serves rtsp://<hub-ip>:<port>/cam0 for one interleaved TCP viewer.

endmenu
```

## components/minihub_store/Kconfig.minihub
```kconfig
menu "Store"

    config MINIHUB_STORE
        bool "Enable MiniHub Store (catalog download for packs/modules)"
        default y

    config MINIHUB_STORE_URL
        string "MiniHub Store server URL (full URL, including scheme, e.g. https://minihub.espressif.com)"
        depends on MINIHUB_STORE
        default "https://minihub.espressif.com"

    config MINIHUB_STORAGE_MIN_FREE_BYTES
        int "Minimum free bytes that must remain on the storage partition"
        depends on MINIHUB_STORE
        default 262144
        range 0 4194304
        help
            Refuses a Store install that would leave less than this much free on
            the LittleFS ``storage`` partition (``/data``). That partition also
            holds editable UI JSON and device runtime state, so an install that
            fills it can still break the next UI write. Counts the whole
            partition, not one directory: ``/data/ui`` is already in the used
            figure. Default 256 KiB.

endmenu
```

## components/minihub_thread/Kconfig.minihub
```kconfig
menu "Thread"

    config MINIHUB_THREAD_ADAPTER
        bool "Enable Thread radio (OpenThread Border Router)"
        default n
        select MINIHUB_MATTER_ADAPTER
        select OPENTHREAD_ENABLED
        select ESP_COEX_SW_COEXIST_ENABLE
        help
            OpenThread Border Router on native 802.15.4. Implies Matter.
            Host uplink is Ethernet — keep CONFIG_ENABLE_WIFI_STATION off so
            CHIP does not call esp_wifi_connect() beside MiniHub/OT BR.

endmenu
```

## components/minihub_usb_msc/Kconfig
```kconfig
menu "MiniHub USB MSC"

    config MINIHUB_USB_MSC
        bool "Enable USB Host MSC (U-disk mount)"
        default y if IDF_TARGET_ESP32S31
        default n
        help
            Mount a FAT-formatted USB flash drive at /usb0 for RTSP recording
            and other storage. Requires USB-OTG host wiring on the board.

    config MINIHUB_USB_MSC_MOUNT_PATH
        string "Primary MSC mount path"
        depends on MINIHUB_USB_MSC
        default "/usb0"

endmenu
```

## components/minihub_vibe/Kconfig.minihub
```kconfig
menu "Vibe Mode"

    config MINIHUB_VIBE_SDMMC
        bool "Vibe Mode: probe SDMMC for /Firmware"
        default y if IDF_TARGET_ESP32S31
        help
            Mount a LittleFS volume on an SDMMC card. The card must already hold
            a LittleFS filesystem; Vibe Mode never reformats it by default.

    config MINIHUB_VIBE_SD_BUS_WIDTH
        int "Vibe Mode: SDMMC bus width"
        depends on MINIHUB_VIBE_SDMMC
        default 1
        range 1 4

    config MINIHUB_VIBE_SD_PIN_CLK
        int "SDMMC CLK GPIO (-1 = use the SoC default)"
        depends on MINIHUB_VIBE_SDMMC
        default -1

    config MINIHUB_VIBE_SD_PIN_CMD
        int "SDMMC CMD GPIO (-1 = use the SoC default)"
        depends on MINIHUB_VIBE_SDMMC
        default -1

    config MINIHUB_VIBE_SD_PIN_D0
        int "SDMMC D0 GPIO (-1 = use the SoC default)"
        depends on MINIHUB_VIBE_SDMMC
        default -1

    config MINIHUB_VIBE_SD_PIN_D1
        int "SDMMC D1 GPIO (-1 = use the SoC default)"
        depends on MINIHUB_VIBE_SDMMC && MINIHUB_VIBE_SD_BUS_WIDTH = 4
        default -1

    config MINIHUB_VIBE_SD_PIN_D2
        int "SDMMC D2 GPIO (-1 = use the SoC default)"
        depends on MINIHUB_VIBE_SDMMC && MINIHUB_VIBE_SD_BUS_WIDTH = 4
        default -1

    config MINIHUB_VIBE_SD_PIN_D3
        int "SDMMC D3 GPIO (-1 = use the SoC default)"
        depends on MINIHUB_VIBE_SDMMC && MINIHUB_VIBE_SD_BUS_WIDTH = 4
        default -1

    config MINIHUB_VIBE_USB
        bool "Vibe Mode: probe USB Host MSC for /Firmware"
        default y if IDF_TARGET_ESP32S31
        help
            Mount a LittleFS volume on a USB mass-storage device. The component
            uses msc_host_get_blockdev() directly, so the stick is NOT mounted
            as FAT and is not readable as a normal drive on a PC.

    config MINIHUB_VIBE_USB_WAIT_MS
        int "Vibe Mode: milliseconds to wait for USB device insertion"
        depends on MINIHUB_VIBE_USB
        default 3000

    config MINIHUB_VIBE_FORMAT_ON_FAIL
        bool "Format an unmountable external volume as LittleFS"
        default n
        help
            Keep off in production: formatting destroys whatever the PC put on
            the card or stick. Enable only for lab bring-up.

    config MINIHUB_VIBE_ENTER_REBOOT_DELAY_MS
        int "Delay before rebooting into Vibe Mode"
        default 800

    config MINIHUB_VIBE_FORCE_GPIO
        int "GPIO to force-apply staged firmware (-1 = disabled)"
        default -1
        range -1 48
        help
            When this GPIO is pressed at Vibe Mode start, copy /Firmware/firmware.bin
            even if minihub/vibe_pending is clear. Use this to recover when the Host
            application cannot arm pending. Set to -1 to ignore the button entirely.
            A matching expected SHA (NVS or firmware.bin.sha256 sidecar) is still
            required before any copy.

    config MINIHUB_VIBE_FORCE_ACTIVE_LOW
        bool "Force-apply GPIO is active low"
        default y
        help
            Active-low is typical for BOOT / recovery buttons (pressed = 0).
            Ignored when MINIHUB_VIBE_FORCE_GPIO is -1.

endmenu
```

## components/minihub_zigbee/Kconfig.minihub
```kconfig
menu "Zigbee"

    config MINIHUB_ZIGBEE_SDK
        bool "Enable Zigbee adapter (ESP-Zigbee-SDK coordinator)"
        default n
        select ZB_ENABLED
        select ESP_COEX_SW_COEXIST_ENABLE

endmenu
```
